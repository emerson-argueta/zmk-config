/* source keypos definitions */
#include "../zmk-nodefree-config/keypos_def/keypos_glv80.h"
#define NAV 1

/* map the Glove's extra keys */
#define X_LT  \
                &kp F1    &kp F2 &kp F3 &kp F4 &kp F5                 &kp F6 &kp F7 &kp F8 &kp F9 &kp F10 \
                &kp EQUAL &kp N1 &kp N2 &kp N3 &kp N4 &kp N5   &kp N6 &kp N7 &kp N8 &kp N9 &kp N0 &kp MINUS \
                &kp TAB
#define X_RT    &kp BACKSLASH

#define X_LM    &kp ESC
#define X_RM    &kp SQT

#define X_LB    &kp LSHIFT
#define X_MB    &mo NAV &smart_mouse &kp ESC   &kp ESC &none &kp GRAVE
#define X_RB    &kp RSHIFT

#define X_LH    &none &kp LCTRL &kp LALT &kp LGUI &kp LBKT 
#define X_MH    &kp LGUI &kp RGUI
#define X_RH    &kp RBKT &kp RGUI &kp RALT &kp RCTRL &kp F13

/* activate bluetooth */
#define CONFIG_WIRELESS 1

/* source the main keymap */
#include "base.keymap"

